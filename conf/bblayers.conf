## conf/bblayers.conf
```bitbake
# POKY_BBLAYERS_CONF_VERSION is increased each time build/conf/bblayers.conf
# changes incompatibly
POKY_BBLAYERS_CONF_VERSION = "2"

BBPATH = "${TOPDIR}"
BBFILES ?= ""

BBLAYERS ?= " \
  /home/mohamed/yocto/layers/poky/meta \
  /home/mohamed/yocto/layers/poky/meta-poky \
  /home/mohamed/yocto/layers/poky/meta-yocto-bsp \
  /home/mohamed/yocto/layers/meta-openembedded/meta-oe \
  /home/mohamed/yocto/layers/meta-openembedded/meta-python \
  /home/mohamed/yocto/layers/meta-qt6 \
  /home/mohamed/yocto/layers/meta-bbb-automotive \
  "
```

## conf/layer.conf
```bitbake
# ==============================================================================
# FICHIER DE CONFIGURATION DU LAYER : meta-bbb-automotive
# Ce fichier permet à BitBake de découvrir et d'indexer ce layer personnalisé.
# ==============================================================================

# 1. AJOUT DES CHEMINS GLOBAUX
# On ajoute le dossier de ce layer au chemin de recherche global de Yocto (BBPATH).
# Cela permet à BitBake de trouver les classes (.bbclass) et les configurations de machines.
BBPATH .= ":${LAYERDIR}"

# 2. LOCALISATION DES RECETTES
# On indique à BitBake où chercher les recettes (.bb) et les extensions (.bbappend).
# La syntaxe "recipes-*/*/*.bb" permet de scanner toute l'arborescence du layer.
BBFILES += "${LAYERDIR}/recipes-*/*/*.bb \
            ${LAYERDIR}/recipes-*/*/*.bbappend"

# 3. DÉCLARATION ET RECONNAISSANCE DU LAYER
# On donne un nom unique (une collection) à ce layer pour l'identifier dans le build.
BBFILE_COLLECTIONS += "meta-bbb-automotive"

# On lie ce nom unique au chemin physique du dossier du layer sur le disque dur.
BBFILE_PATTERN_meta-bbb-automotive = "^${LAYERDIR}/"

# On définit la priorité de ce layer (6 est la valeur standard).
# Si une recette porte le même nom dans un autre layer, la priorité décide laquelle gagne.
BBFILE_PRIORITY_meta-bbb-automotive = "6"

# 4. GESTION DES DÉPENDANCES ET COMPATIBILITÉS
# On déclare que ce layer a impérativement besoin de la couche de base "core" (Poky) pour fonctionner.
LAYERDEPENDS_meta-bbb-automotive = "core"

# On certifie que ce layer est compatible avec la version spécifique "Scarthgap" de Yocto (LTS 2024/2026).
# BitBake bloquera le build si vous tentez d'utiliser ce layer sur une autre version.
LAYERSERIES_COMPAT_meta-bbb-automotive = "scarthgap"
```

## conf/local.conf
```bitbake
# ==============================================================================
# ARCHITECTURE CIBLE
# ==============================================================================
# Spécifie la machine cible pour la compilation.
# "qemux86-64" configure Yocto pour générer des binaires compatibles avec un 
# processeur Intel/AMD 64-bits émulé par QEMU (idéal pour le prototypage sur PC).
MACHINE ?= "qemux86-64"

# ==============================================================================
# GESTION DES CHEMINS ET STOCKAGE (LOGISTIQUE DE BUILD)
# ==============================================================================
# Emplacement de stockage des codes sources bruts (archives .tar.gz, dépôts git) 
# téléchargés depuis Internet. Permet de compiler hors-ligne si déjà peuplé.
DL_DIR ?= "${TOPDIR}/../downloads"

# Emplacement du cache des états partagés (Shared State Cache). Contient les 
# versions pré-compilées des tâches intermédiaires pour accélérer drastiquement 
# les builds futurs en évitant les recompilations inutiles.
SSTATE_DIR ?= "${TOPDIR}/../sstate-cache"

# Répertoire de travail temporaire principal où se déroulent les étapes de 
# configuration, de compilation croisée et d'assemblage du RootFS.
TMPDIR = "${TOPDIR}/tmp"

# ==============================================================================
# DISTRIBUTION ET GESTION DES PACKAGES
# ==============================================================================
# Sélectionne la distribution Linux de référence (Poky est la distrib de base du projet Yocto).
DISTRO ?= "poky"

# Définit le format d'encapsulation des paquets logiciels. Ici, le format RPM.
PACKAGE_CLASSES ?= "package_rpm"

# Fonctionnalités additionnelles de l'image de base :
# - debug-tweaks : Désactive les restrictions de sécurité (permet l'accès root sans mot de passe).
# - ssh-server-openssh : Intègre le serveur OpenSSH natif pour le contrôle à distance.
EXTRA_IMAGE_FEATURES ?= "debug-tweaks ssh-server-openssh" 

# Active la collecte des statistiques de build (temps de build, utilisation CPU/RAM par tâche).
USER_CLASSES ?= "buildstats"

# Définit le comportement en cas d'échec de l'application d'un patch ("noop" = ne rien faire).
PATCHRESOLVE = "noop"

# ==============================================================================
# SURVEILLANCE DE L'ESPACE DISQUE HÔTE
# ==============================================================================
# Sécurité pour éviter la saturation du disque dur de la machine hôte (Ubuntu) :
# - STOPTASKS : Arrête le lancement de nouvelles tâches si l'espace descend sous 1 Go ou 100k inodes.
# - HALT : Interrompt immédiatement tout le processus si l'espace descend sous 100 Mo ou 1k inodes.
BB_DISKMON_DIRS ??= "STOPTASKS,${TMPDIR},1G,100K HALT,${TMPDIR},100M,1K"

# ==============================================================================
# CONFIGURATION DU SYSTÈME D'INITIALISATION ET GRAPHISME (STACK MODERNE)
# ==============================================================================
# Ajout de fonctionnalités globales à la distribution :
# - opengl & wayland : Support de l'accélération matérielle 3D et du serveur d'affichage moderne Wayland (remplaçant de X11).
# - systemd : Intégration du gestionnaire de services moderne pour un démarrage parallélisé.
# - usrmerge : Fusion des répertoires de binaires vers /usr/bin et /usr/sbin (standard Linux moderne).
DISTRO_FEATURES:append = " opengl wayland systemd usrmerge"

# Indique à Yocto de ne pas injecter l'ancien système sysvinit en arrière-plan.
DISTRO_FEATURES_BACKFILL_CONSIDERED += "sysvinit"

# Force l'utilisation de systemd comme gestionnaire de démarrage et d'initialisation par défaut.
VIRTUAL-RUNTIME_init_manager = "systemd"
VIRTUAL-RUNTIME_initscripts = "systemd-compat-units"

# ==============================================================================
# INJECTION DES PAQUETS APPLICATIFS 
# ==============================================================================
# Liste des paquets logiciels personnalisés et dépendances à installer dans le RootFS final :
IMAGE_INSTALL:append = " \
    qtbase \
    qtdeclarative \
    qtshadertools \
    python3-core \
    python3-modules \
    python3-io \
    python3-datetime \
    automotive-dashboard-new  \
    python-simulator-script \
    dashboard-service \
    fontconfig \
    ttf-dejavu-sans \
    ttf-dejavu-sans-mono \
    liberation-fonts \
"
# Explications du bloc d'installation :
# - qt* : Framework graphique (Qt6/Qt5) nécessaire pour l'interface du tableau de bord.
# - python3* : Environnement d'exécution Python requis pour faire tourner la logique métier.
# - automotive-dashboard-new : L'application IHM du tableau de bord automobile.
# - python-simulator-script : Script générant/simulant les données véhicules (vitesse, RPM, etc.).
# - dashboard-service : Script de gestion de service (systemd) assurant le lancement automatique du projet au boot.
# - fontconfig & ttf-* : Serveur de polices et fontes vectorielles indispensables pour afficher du texte dans l'IHM Qt.

# ==============================================================================
# CONFIGURATION ET AFFICHAGE QEMU
# ==============================================================================
# Ajoute le support de la bibliothèque graphique SDL lors de la compilation native de QEMU.
PACKAGECONFIG:append:pn-qemu-system-native = " sdl"

# Active explicitement l'affichage via une interface graphique SDL sur la machine hôte.
# C'est ce paramètre qui force QEMU à ouvrir une fenêtre pop-up affichant l'IHM de ton tableau de bord.
QEUMU_USE_SDL = "1"

# ==============================================================================
# OPTIMISATIONS ET DIMENSIONNEMENT IMAGE
# ==============================================================================
# Force la suppression des fichiers de travail intermédiaires dès qu'une tâche est validée.
# Réduit drastiquement l'espace disque final requis sur ton Ubuntu (économie de dizaines de Go).
INHERIT += "rm_work"

# Version interne de configuration utilisée par la couche de métadonnées.
CONF_VERSION = "2"

# Ajoute un espace de stockage libre supplémentaire de 1 Go (1048576 Ko) dans le RootFS.
# Permet au développeur de pouvoir créer des fichiers, des logs ou transférer du code à la volée durant les phases de test.
IMAGE_ROOTFS_EXTRA_SPACE = "1048576"
```
